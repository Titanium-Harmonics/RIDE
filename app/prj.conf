## CMakeLists.txt
```
cmake_minimum_required(VERSION 3.20.0)

list(APPEND BOARD_ROOT ${CMAKE_CURRENT_LIST_DIR}/..)

find_package(Zephyr REQUIRED HINTS $ENV{ZEPHYR_BASE})
project(ride_mk1)

target_sources(app PRIVATE
    src/main.c
    src/ride_buttons.c
    src/ride_input_manager.c
    src/ride_terminal.c
    src/ride_command_dispatcher.c
    src/ride_shell.c
)
target_include_directories(app PRIVATE include)
```

## prj.conf
```kconfig
CONFIG_SERIAL=y
CONFIG_CONSOLE=y
CONFIG_UART_CONSOLE=y
CONFIG_SHELL=y
CONFIG_SHELL_BACKEND_SERIAL=y
```

## boards/esp32c3_devkitm.overlay
```dts
/ {
    chosen {
        zephyr,console = &usb_serial;
        zephyr,shell-uart = &usb_serial;
    };
};
```

## src/main.c
```c
#include "ride_shell.h"

int main(void)
{
    ride_shell_init();
    return 0;
}
```

## include/ride_buttons.h
```c
#ifndef RIDE_BUTTONS_H_
#define RIDE_BUTTONS_H_

#include <stdbool.h>
#include <stdint.h>

typedef enum
{
    RIDE_BTN_REC,
    RIDE_BTN_LEFT,
    RIDE_BTN_RIGHT,
    RIDE_BTN_ENTER,
    RIDE_BTN_BACK,
    RIDE_BTN_ACTION,
    RIDE_BTN_COUNT
} ride_button_t;

typedef enum
{
    RIDE_PRESS_SHORT,
    RIDE_PRESS_LONG
} ride_press_t;

typedef enum
{
    RIDE_CMD_NONE,
    RIDE_CMD_RECORD_TOGGLE,
    RIDE_CMD_NAV_PREVIOUS,
    RIDE_CMD_NAV_NEXT,
    RIDE_CMD_NAV_SELECT,
    RIDE_CMD_NAV_BACK,
    RIDE_CMD_UI_GO_HOME,
    RIDE_CMD_EVENT_LOG
} ride_command_t;

typedef struct
{
    ride_button_t button;
    ride_press_t press;
} ride_button_event_t;

typedef struct
{
    ride_command_t short_press;
    ride_command_t long_press;
} ride_action_mapping_t;

typedef struct
{
    bool down;
    bool long_emitted;
    uint32_t pressed_at_ms;
} ride_button_state_t;

typedef struct
{
    ride_button_state_t states[RIDE_BTN_COUNT];
    bool ignored_down[RIDE_BTN_COUNT];
    ride_button_t active_button;
    ride_action_mapping_t action;
    uint32_t long_press_ms;
} ride_button_engine_t;

typedef void (*ride_button_event_fn)(ride_button_event_t event, void* context);

void ride_buttons_init(ride_button_engine_t* engine, uint32_t long_press_ms);
bool ride_buttons_set_action_mapping(ride_button_engine_t* engine, ride_action_mapping_t mapping);
ride_command_t ride_buttons_resolve(const ride_button_engine_t* engine, ride_button_event_t event);
void ride_buttons_edge(ride_button_engine_t* engine, ride_button_t button, bool down,
                       uint32_t now_ms, ride_button_event_fn emit, void* context);
void ride_buttons_tick(ride_button_engine_t* engine, uint32_t now_ms, ride_button_event_fn emit,
                       void* context);

#endif
```

## include/ride_command_dispatcher.h
```c
#ifndef RIDE_COMMAND_DISPATCHER_H_
#define RIDE_COMMAND_DISPATCHER_H_

#include "ride_input_manager.h"
#include "ride_terminal.h"

typedef enum
{
    RIDE_DISPATCH_OK,
    RIDE_DISPATCH_INVALID,
    RIDE_DISPATCH_UNAVAILABLE
} ride_dispatch_result_t;

typedef struct
{
    ride_input_manager_t* inputs;
    ride_button_event_fn emit;
    void* context;
} ride_command_dispatcher_t;

void ride_command_dispatcher_init(ride_command_dispatcher_t* dispatcher,
                                  ride_input_manager_t* inputs, ride_button_event_fn emit,
                                  void* context);
ride_dispatch_result_t ride_command_dispatcher_execute(ride_command_dispatcher_t* dispatcher,
                                                       const ride_terminal_command_t* command,
                                                       uint32_t now_ms);

#endif
```

## include/ride_input_manager.h
```c
#ifndef RIDE_INPUT_MANAGER_H_
#define RIDE_INPUT_MANAGER_H_

#include "ride_buttons.h"

typedef enum
{
    RIDE_INPUT_GPIO,
    RIDE_INPUT_CONSOLE,
    RIDE_INPUT_KEYBOARD,
    RIDE_INPUT_SOURCE_COUNT
} ride_input_source_t;

typedef struct
{
    ride_button_engine_t* engine;
    bool pressed[RIDE_INPUT_SOURCE_COUNT][RIDE_BTN_COUNT];
} ride_input_manager_t;

void ride_input_manager_init(ride_input_manager_t* manager, ride_button_engine_t* engine);
void ride_input_manager_set(ride_input_manager_t* manager, ride_input_source_t source,
                            ride_button_t button, bool pressed, uint32_t now_ms,
                            ride_button_event_fn emit, void* context);
void ride_input_manager_clear_source(ride_input_manager_t* manager, ride_input_source_t source,
                                     uint32_t now_ms, ride_button_event_fn emit, void* context);
bool ride_input_manager_is_pressed(const ride_input_manager_t* manager, ride_button_t button);

#endif
```

## include/ride_shell.h
```c
#ifndef RIDE_SHELL_H_
#define RIDE_SHELL_H_

void ride_shell_init(void);

#endif
```

## include/ride_terminal.h
```c
#ifndef RIDE_TERMINAL_H_
#define RIDE_TERMINAL_H_

#include "ride_buttons.h"

typedef enum
{
    RIDE_TERMINAL_INVALID,
    RIDE_TERMINAL_HELP,
    RIDE_TERMINAL_STATUS,
    RIDE_TERMINAL_BUTTONS_STATUS,
    RIDE_TERMINAL_BUTTON
} ride_terminal_command_type_t;

typedef enum
{
    RIDE_TERMINAL_PRESS,
    RIDE_TERMINAL_RELEASE
} ride_terminal_button_action_t;

typedef struct
{
    ride_terminal_command_type_t type;
    ride_button_t button;
    ride_terminal_button_action_t action;
} ride_terminal_command_t;

/* Parses one command without allocating memory or modifying the input. */
bool ride_terminal_parse(const char* line, ride_terminal_command_t* output);

#endif
```

## src/ride_buttons.c
```c
#include "ride_buttons.h"

#include <stddef.h>
#include <string.h>

static const ride_action_mapping_t defaults[RIDE_BTN_COUNT] = {
    [RIDE_BTN_REC] = {RIDE_CMD_RECORD_TOGGLE, RIDE_CMD_RECORD_TOGGLE},
    [RIDE_BTN_LEFT] = {RIDE_CMD_NAV_PREVIOUS, RIDE_CMD_NAV_PREVIOUS},
    [RIDE_BTN_RIGHT] = {RIDE_CMD_NAV_NEXT, RIDE_CMD_NAV_NEXT},
    [RIDE_BTN_ENTER] = {RIDE_CMD_NAV_SELECT, RIDE_CMD_NAV_SELECT},
    [RIDE_BTN_BACK] = {RIDE_CMD_NAV_BACK, RIDE_CMD_UI_GO_HOME},
    [RIDE_BTN_ACTION] = {RIDE_CMD_EVENT_LOG, RIDE_CMD_EVENT_LOG},
};

static bool valid_command(ride_command_t command)
{
    return command >= RIDE_CMD_NONE && command <= RIDE_CMD_EVENT_LOG;
}

void ride_buttons_init(ride_button_engine_t* engine, uint32_t long_press_ms)
{
    if (engine == NULL)
    {
        return;
    }
    memset(engine, 0, sizeof(*engine));
    engine->active_button = RIDE_BTN_COUNT;
    engine->action = defaults[RIDE_BTN_ACTION];
    engine->long_press_ms = long_press_ms == 0 ? 800U : long_press_ms;
}

bool ride_buttons_set_action_mapping(ride_button_engine_t* engine, ride_action_mapping_t mapping)
{
    if (engine == NULL || !valid_command(mapping.short_press) || !valid_command(mapping.long_press))
    {
        return false;
    }
    engine->action = mapping;
    return true;
}

ride_command_t ride_buttons_resolve(const ride_button_engine_t* engine, ride_button_event_t event)
{
    if (engine == NULL || event.button < RIDE_BTN_REC || event.button >= RIDE_BTN_COUNT ||
        (event.press != RIDE_PRESS_SHORT && event.press != RIDE_PRESS_LONG))
    {
        return RIDE_CMD_NONE;
    }
    ride_action_mapping_t mapping =
        event.button == RIDE_BTN_ACTION ? engine->action : defaults[event.button];
    return event.press == RIDE_PRESS_SHORT ? mapping.short_press : mapping.long_press;
}

static void emit_event(ride_button_event_fn emit, void* context, ride_button_t button,
                       ride_press_t press)
{
    if (emit != NULL)
    {
        emit((ride_button_event_t){button, press}, context);
    }
}

void ride_buttons_edge(ride_button_engine_t* engine, ride_button_t button, bool down,
                       uint32_t now_ms, ride_button_event_fn emit, void* context)
{
    if (engine == NULL || button < RIDE_BTN_REC || button >= RIDE_BTN_COUNT)
    {
        return;
    }
    ride_button_state_t* state = &engine->states[button];
    if (down)
    {
        if (state->down || engine->ignored_down[button])
        {
            return;
        }
        if (engine->active_button != RIDE_BTN_COUNT)
        {
            engine->ignored_down[button] = true;
            return;
        }
        engine->active_button = button;
        state->down = true;
        state->pressed_at_ms = now_ms;
        return;
    }
    if (engine->ignored_down[button])
    {
        engine->ignored_down[button] = false;
        return;
    }
    if (!state->down || engine->active_button != button)
    {
        return;
    }
    state->down = false;
    engine->active_button = RIDE_BTN_COUNT;
    uint32_t duration = now_ms - state->pressed_at_ms;
    emit_event(emit, context, button,
               duration >= engine->long_press_ms ? RIDE_PRESS_LONG : RIDE_PRESS_SHORT);
}

void ride_buttons_tick(ride_button_engine_t* engine, uint32_t now_ms, ride_button_event_fn emit,
                       void* context)
{
    /* Classification is determined at release. No action fires while held. */
    (void)engine;
    (void)now_ms;
    (void)emit;
    (void)context;
}
```

## src/ride_command_dispatcher.c
```c
#include "ride_command_dispatcher.h"

void ride_command_dispatcher_init(ride_command_dispatcher_t* dispatcher,
                                  ride_input_manager_t* inputs, ride_button_event_fn emit,
                                  void* context)
{
    if (!dispatcher)
        return;
    dispatcher->inputs = inputs;
    dispatcher->emit = emit;
    dispatcher->context = context;
}

ride_dispatch_result_t ride_command_dispatcher_execute(ride_command_dispatcher_t* dispatcher,
                                                       const ride_terminal_command_t* command,
                                                       uint32_t now_ms)
{
    if (!dispatcher || !command)
        return RIDE_DISPATCH_INVALID;
    if (command->type == RIDE_TERMINAL_HELP || command->type == RIDE_TERMINAL_STATUS ||
        command->type == RIDE_TERMINAL_BUTTONS_STATUS)
        return RIDE_DISPATCH_OK;
    if (command->type != RIDE_TERMINAL_BUTTON || command->button >= RIDE_BTN_COUNT ||
        (command->action != RIDE_TERMINAL_PRESS && command->action != RIDE_TERMINAL_RELEASE))
        return RIDE_DISPATCH_INVALID;
    if (!dispatcher->inputs || !dispatcher->inputs->engine)
        return RIDE_DISPATCH_UNAVAILABLE;
    ride_input_manager_set(dispatcher->inputs, RIDE_INPUT_CONSOLE, command->button,
                           command->action == RIDE_TERMINAL_PRESS, now_ms, dispatcher->emit,
                           dispatcher->context);
    return RIDE_DISPATCH_OK;
}
```

## src/ride_input_manager.c
```c
#include "ride_input_manager.h"

#include <stddef.h>
#include <string.h>

static bool valid_source(ride_input_source_t source)
{
    return source >= RIDE_INPUT_GPIO && source < RIDE_INPUT_SOURCE_COUNT;
}

static bool valid_button(ride_button_t button)
{
    return button >= RIDE_BTN_REC && button < RIDE_BTN_COUNT;
}

bool ride_input_manager_is_pressed(const ride_input_manager_t* manager, ride_button_t button)
{
    if (manager == NULL || !valid_button(button))
    {
        return false;
    }

    for (unsigned int source = 0U; source < RIDE_INPUT_SOURCE_COUNT; ++source)
    {
        if (manager->pressed[source][button])
        {
            return true;
        }
    }
    return false;
}

void ride_input_manager_init(ride_input_manager_t* manager, ride_button_engine_t* engine)
{
    if (manager == NULL)
    {
        return;
    }
    memset(manager, 0, sizeof(*manager));
    manager->engine = engine;
}

void ride_input_manager_set(ride_input_manager_t* manager, ride_input_source_t source,
                            ride_button_t button, bool pressed, uint32_t now_ms,
                            ride_button_event_fn emit, void* context)
{
    if (manager == NULL || manager->engine == NULL || !valid_source(source) ||
        !valid_button(button))
    {
        return;
    }

    bool before = ride_input_manager_is_pressed(manager, button);
    manager->pressed[source][button] = pressed;
    bool after = ride_input_manager_is_pressed(manager, button);
    if (before != after)
    {
        ride_buttons_edge(manager->engine, button, after, now_ms, emit, context);
    }
}

void ride_input_manager_clear_source(ride_input_manager_t* manager, ride_input_source_t source,
                                     uint32_t now_ms, ride_button_event_fn emit, void* context)
{
    if (manager == NULL || !valid_source(source))
    {
        return;
    }

    for (unsigned int button = 0U; button < RIDE_BTN_COUNT; ++button)
    {
        ride_input_manager_set(manager, source, (ride_button_t)button, false, now_ms, emit,
                               context);
    }
}
```

## src/ride_shell.c
```c
#include "ride_shell.h"

#include "ride_command_dispatcher.h"

#include <zephyr/kernel.h>
#include <zephyr/sys/util.h>

#include <errno.h>
#include <string.h>
#include <zephyr/shell/shell.h>

static ride_button_engine_t button_engine;
static ride_input_manager_t input_manager;
static ride_command_dispatcher_t dispatcher;
static const struct shell* active_shell;

static const char* command_name(ride_command_t command)
{
    switch (command)
    {
    case RIDE_CMD_RECORD_TOGGLE:
        return "RECORD_TOGGLE";
    case RIDE_CMD_NAV_PREVIOUS:
        return "NAV_PREVIOUS";
    case RIDE_CMD_NAV_NEXT:
        return "NAV_NEXT";
    case RIDE_CMD_NAV_SELECT:
        return "NAV_SELECT";
    case RIDE_CMD_NAV_BACK:
        return "NAV_BACK";
    case RIDE_CMD_UI_GO_HOME:
        return "UI_GO_HOME";
    case RIDE_CMD_EVENT_LOG:
        return "EVENT_LOG";
    default:
        return "NONE";
    }
}

static void on_button_event(ride_button_event_t event, void* context)
{
    const struct shell* sh = context != NULL ? context : active_shell;
    if (sh != NULL)
    {
        shell_print(sh, "[E] %s", command_name(ride_buttons_resolve(&button_engine, event)));
    }
}

static int dispatch(const struct shell* sh, ride_terminal_command_t command)
{
    active_shell = sh;
    dispatcher.context = (void*)sh;
    ride_dispatch_result_t result =
        ride_command_dispatcher_execute(&dispatcher, &command, k_uptime_get_32());
    if (result != RIDE_DISPATCH_OK)
    {
        shell_error(sh, "Command unavailable or invalid");
        return -EINVAL;
    }

    switch (command.type)
    {
    case RIDE_TERMINAL_HELP:
        shell_print(
            sh, "ride help | ride status | ride buttons status | ride button <name> press|release");
        break;
    case RIDE_TERMINAL_STATUS:
        shell_print(sh, "RIDE firmware running");
        break;
    case RIDE_TERMINAL_BUTTONS_STATUS:
        shell_print(sh, "active=%d", (int)button_engine.active_button);
        break;
    default:
        shell_print(sh, "[OK] button edge accepted");
        break;
    }
    return 0;
}

static int cmd_help(const struct shell* sh, size_t argc, char** argv)
{
    ARG_UNUSED(argc);
    ARG_UNUSED(argv);
    return dispatch(sh, (ride_terminal_command_t){.type = RIDE_TERMINAL_HELP});
}

static int cmd_status(const struct shell* sh, size_t argc, char** argv)
{
    ARG_UNUSED(argc);
    ARG_UNUSED(argv);
    return dispatch(sh, (ride_terminal_command_t){.type = RIDE_TERMINAL_STATUS});
}

static int cmd_buttons_status(const struct shell* sh, size_t argc, char** argv)
{
    ARG_UNUSED(argc);
    ARG_UNUSED(argv);
    return dispatch(sh, (ride_terminal_command_t){.type = RIDE_TERMINAL_BUTTONS_STATUS});
}

static int cmd_button(const struct shell* sh, size_t argc, char** argv)
{
    ARG_UNUSED(argc);
    static const char* const names[] = {"rec", "left", "right", "enter", "back", "action"};
    ride_button_t button = RIDE_BTN_COUNT;
    for (size_t i = 0; i < ARRAY_SIZE(names); ++i)
    {
        if (strcmp(argv[1], names[i]) == 0)
        {
            button = (ride_button_t)i;
            break;
        }
    }
    if (button == RIDE_BTN_COUNT)
    {
        shell_error(sh, "Unknown button");
        return -EINVAL;
    }

    ride_terminal_button_action_t action;
    if (strcmp(argv[2], "press") == 0)
        action = RIDE_TERMINAL_PRESS;
    else if (strcmp(argv[2], "release") == 0)
        action = RIDE_TERMINAL_RELEASE;
    else
    {
        shell_error(sh, "Expected press or release");
        return -EINVAL;
    }

    return dispatch(sh, (ride_terminal_command_t){
                            .type = RIDE_TERMINAL_BUTTON, .button = button, .action = action});
}

SHELL_STATIC_SUBCMD_SET_CREATE(buttons_subcommands,
                               SHELL_CMD_ARG(status, NULL, "Show effective button state",
                                             cmd_buttons_status, 1, 0),
                               SHELL_SUBCMD_SET_END);

SHELL_STATIC_SUBCMD_SET_CREATE(
    ride_subcommands, SHELL_CMD_ARG(help, NULL, "Show RIDE commands", cmd_help, 1, 0),
    SHELL_CMD_ARG(status, NULL, "Show firmware status", cmd_status, 1, 0),
    SHELL_CMD_ARG(buttons, &buttons_subcommands, "Button state commands", NULL, 1, 0),
    SHELL_CMD_ARG(button, NULL, "Inject a button edge: <name> press|release", cmd_button, 3, 0),
    SHELL_SUBCMD_SET_END);

SHELL_CMD_REGISTER(ride, &ride_subcommands, "R.I.D.E. firmware commands", NULL);

void ride_shell_init(void)
{
    ride_buttons_init(&button_engine, 800U);
    ride_input_manager_init(&input_manager, &button_engine);
    ride_command_dispatcher_init(&dispatcher, &input_manager, on_button_event, NULL);
}
```

## src/ride_terminal.c
```c
#include "ride_terminal.h"

#include <ctype.h>
#include <stddef.h>
#include <string.h>

#define RIDE_TERMINAL_MAX_LINE 96U
#define RIDE_TERMINAL_MAX_TOKENS 4U

static bool token_equals(const char* token, const char* name)
{
    return strcmp(token, name) == 0;
}

static bool parse_button(const char* token, ride_button_t* button)
{
    static const char* const names[] = {"rec", "left", "right", "enter", "back", "action"};

    for (unsigned int i = 0U; i < RIDE_BTN_COUNT; ++i)
    {
        if (token_equals(token, names[i]))
        {
            *button = (ride_button_t)i;
            return true;
        }
    }

    return false;
}

static bool parse_action(const char* token, ride_terminal_button_action_t* action)
{
    static const char* const names[] = {"press", "release"};

    for (unsigned int i = 0U; i < 2U; ++i)
    {
        if (token_equals(token, names[i]))
        {
            *action = (ride_terminal_button_action_t)i;
            return true;
        }
    }

    return false;
}

bool ride_terminal_parse(const char* line, ride_terminal_command_t* output)
{
    char buffer[RIDE_TERMINAL_MAX_LINE];
    char* tokens[RIDE_TERMINAL_MAX_TOKENS] = {NULL};
    size_t length;
    unsigned int count = 0U;
    char* cursor;

    if (output == NULL)
    {
        return false;
    }

    memset(output, 0, sizeof(*output));
    output->type = RIDE_TERMINAL_INVALID;

    if (line == NULL)
    {
        return false;
    }

    length = strlen(line);
    if (length == 0U || length >= sizeof(buffer))
    {
        return false;
    }

    memcpy(buffer, line, length + 1U);
    cursor = buffer;

    while (*cursor != '\0')
    {
        while (isspace((unsigned char)*cursor))
        {
            ++cursor;
        }

        if (*cursor == '\0')
        {
            break;
        }

        if (count >= RIDE_TERMINAL_MAX_TOKENS)
        {
            return false;
        }

        tokens[count++] = cursor;
        while (*cursor != '\0' && !isspace((unsigned char)*cursor))
        {
            ++cursor;
        }

        if (*cursor != '\0')
        {
            *cursor++ = '\0';
        }
    }

    if (count == 1U && token_equals(tokens[0], "help"))
    {
        output->type = RIDE_TERMINAL_HELP;
    }
    else if (count == 1U && token_equals(tokens[0], "status"))
    {
        output->type = RIDE_TERMINAL_STATUS;
    }
    else if (count == 2U && token_equals(tokens[0], "buttons") && token_equals(tokens[1], "status"))
    {
        output->type = RIDE_TERMINAL_BUTTONS_STATUS;
    }
    else if (count == 3U && token_equals(tokens[0], "button") &&
             parse_button(tokens[1], &output->button) && parse_action(tokens[2], &output->action))
    {
        output->type = RIDE_TERMINAL_BUTTON;
    }

    return output->type != RIDE_TERMINAL_INVALID;
}
```

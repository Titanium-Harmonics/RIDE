## boards/titanium_harmonics/ride_esp32c3/Kconfig.ride_esp32c3
```kconfig
# SPDX-License-Identifier: Apache-2.0

config BOARD_RIDE_ESP32C3
    select SOC_ESP32C3_MINI_N4
```

## boards/titanium_harmonics/ride_esp32c3/board.yml
```yaml
board:
  name: ride_esp32c3
  full_name: R.I.D.E. ESP32-C3 Super Mini Prototype
  vendor: titanium_harmonics
  socs:
    - name: esp32c3
```

## tests/ci/button_engine/testcase.yaml
```yaml
tests:
  ride.button_engine:
    platform_allow:
      - native_sim
    tags:
      - ride
      - button
```

## tests/ci/ztest_smoke/testcase.yaml
```yaml
tests:
  ride.ci.message_queue:
    tags:
      - ride
      - ci
    platform_allow:
      - native_sim
    integration_platforms:
      - native_sim
```
